## boards/shields/DecaDeca/Kconfig.defconfig
```kconfig
if SHIELD_DECADECA_LEFT

config ZMK_KEYBOARD_NAME
    default "DecaDeca_Split"

config ZMK_SPLIT_ROLE_CENTRAL
    default y

endif

if SHIELD_DECADECA_LEFT || SHIELD_DECADECA_RIGHT

config ZMK_SPLIT
    default y

endif
```

## boards/shields/DecaDeca/Kconfig.shield
```kconfig
config SHIELD_DECADECA_LEFT
    def_bool $(shields_list_contains,DecaDeca_left)

config SHIELD_DECADECA_RIGHT
    def_bool $(shields_list_contains,DecaDeca_right)
```

## boards/shields/decadeca/Kconfig.defconfig
```kconfig
if SHIELD_DECADECA_LEFT

config ZMK_KEYBOARD_NAME
    default "Decadeca_Split"

config ZMK_SPLIT_ROLE_CENTRAL
    default y

endif

if SHIELD_DECADECA_LEFT || SHIELD_DECADECA_RIGHT

config ZMK_SPLIT
    default y

endif
```

## boards/shields/decadeca/Kconfig.shield
```kconfig
config SHIELD_DECADECA_LEFT
    def_bool $(shields_list_contains,decadeca_left)

config SHIELD_DECADECA_RIGHT
    def_bool $(shields_list_contains,decadeca_right)
```
